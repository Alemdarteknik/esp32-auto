## main/Kconfig.projbuild
```kconfig
menu "Universal Modbus inverter gateway"

config INVERTER_GATEWAY_MONITOR_OUTPUT_DEFAULT
    bool "Enable serial monitor diagnostics by default"
    default n
    help
        Print information messages, Modbus TX/RX frames, and successful CRC
        checks to the serial monitor by default. The installer can override
        this from the setup webpage. Warnings and errors remain visible when
        this is disabled.

endmenu
```

## sdkconfig.defaults
```kconfig
CONFIG_IDF_TARGET="esp32s3"
CONFIG_COMPILER_CXX_EXCEPTIONS=y
CONFIG_COMPILER_CXX_EXCEPTIONS_EMG_POOL_SIZE=0
CONFIG_PARTITION_TABLE_SINGLE_APP_LARGE=y
CONFIG_MBEDTLS_CERTIFICATE_BUNDLE=y
CONFIG_MBEDTLS_CERTIFICATE_BUNDLE_DEFAULT_FULL=y
```
